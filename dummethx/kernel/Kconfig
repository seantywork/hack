## dummethx/kernel/Kconfig
```kconfig
config DUMMETHX
	tristate "dummethx kernel module"
	help
	  Dumber than dummies.
```

## dummy2/Kconfig
```kconfig
config DUMMY2
	tristate "dummy module 2"
	help
	  It claims to be a kernel dummy module.
	  dummy2. 
```

## veth/Kconfig
```kconfig
config VETH2
	tristate "Virtual ethernet pair device 2"
	select PAGE_POOL
	help
	  This device is a local ethernet tunnel. Devices are created in pairs.
	  When one end receives the packet it appears on its pair and vice
	  versa.
```
